/*
  * Author: Alex Ferguson
  * Created: 23/01/25

  * Title: B31DG Assignment 1

  * Description: 
  * This program generates a waveform on two GPIO pins which can be viewed via an oscilloscope 
  * or visually via LEDs. 
  * 
  * The waveform is controlled with 2 push buttons. The first button enables or disables the output
  * and the second one toggles between the regular and alternative waveforms. The alternative waveform
  * mode for this program produces the original waveform in reverse i.e. from largest pulse to smallest 
  * pulse 
  * 
  * This program also includes a debug timing mode and a production timing mode. The debug timing mode
  * slows the waveform timings down by a factor of 1000 and this is controlled by setting DEBUG_TIMING
  * to 0 (production) or 1 (debug). The debug timing allows for the program to be debugged visually via 
  * the LEDs
  *
*/

#define DATA 25               // sync LED pin
#define SYNC 26               // data LED pin
#define OUTPUT_ENABLE_PIN 12  // output enable push button pin
#define OUTPUT_SELECT_PIN 14  // output select push button pin
#define DEBUG_TIMING 0        // toggle for debug scaling, 0 = production timing, 1 = debug timing
#define DEBUG_SCALING 1000    // constant to multiply timings by for debug mode 

// conditional compilation statements for debug timing and production timing
// debug timing multiplies timings by DEBUG_SCALING factor
#if DEBUG_TIMING
  const int dataOnInital = 600 * DEBUG_SCALING;
  const int dataOff = 500 * DEBUG_SCALING;
  const int idleTime = 3500 * DEBUG_SCALING;
  const int tSync = 50 * DEBUG_SCALING;
#else //production timing
  const int dataOnInital = 600;
  const int dataOff = 500;
  const int idleTime = 3500;
  const int tSync = 50;
#endif

const int pulseCount = 13;    // number of pulses to be generated by the waveform 
const int debounceTime = 50;  // debounce time for output enable and output select button presses

// volatile variables for button press interrupts
volatile unsigned long buttonTime = 0;
volatile unsigned long lastButtonTime = 0;

volatile bool enableState = false;
volatile bool selectState = false; 

/* isr for the output enable and output select buttons
   
   checks time between button presses and only executes code if the time is greater 
   than that defined by debounceTime to remove unwanted input noise from button presses 
   
   when code executes, the button state variable is toggled which is checked by main 
   program loop to determine if a waveform is to be output and which waveform should be 
   generated
   */
void IRAM_ATTR outputEnable(){
  buttonTime = millis();
  if(buttonTime - lastButtonTime > debounceTime){
    enableState = !enableState;
    lastButtonTime = buttonTime; 
  }
}

// isr for output select button
void IRAM_ATTR outputSelect(){
  buttonTime = millis();
  if(buttonTime - lastButtonTime > debounceTime){
    selectState = !selectState;
    lastButtonTime = buttonTime;
  }
}

/* function to calculate the on time each pulse in the data signal as defined 
  in the documentation */
int tOn(int n){
  int onTime = (dataOnInital + ((n-1)*tSync));
  return onTime;
}

// function to generate the sync pulse signal
// Sets sync pin high for time determined by tSync 
void syncPulse() {
  digitalWrite(SYNC, HIGH);
  delayMicroseconds(tSync);
  digitalWrite(SYNC, LOW);
}

/* function to generate the original waveform */ 
void waveformGen(){
  digitalWrite(DATA, HIGH);
  delayMicroseconds(dataOnInitial);
  digitalWrite(DATA, LOW);
  delayMicroseconds(dataOff);
  for(int iter = 2; iter <= pulseCount; iter++){
    digitalWrite(DATA, HIGH);
    delayMicroseconds(tOn(iter));
    digitalWrite(DATA, LOW);
    delayMicroseconds(dataOff);
  } 
}

/* Generate a reversed form of the data waveform (from the largest pulse to the shortest) 
   until the Output Select push button is pressed again */
void WaveformGenAlt(){
  for(int iter = pulseCount; iter > 0; iter--){
    digitalWrite(DATA, HIGH);
    delayMicroseconds(tOn(iter));
    digitalWrite(DATA, LOW);
    delayMicroseconds(dataOff);
  }
}

void setup() {
  // setup for gpio pins
  pinMode(DATA, OUTPUT);
  pinMode(SYNC, OUTPUT);
  pinMode(OUTPUT_ENABLE_PIN, INPUT);
  pinMode(OUTPUT_SELECT_PIN, INPUT);

  /* enable interrupts on falling edge of button presses attached to output enable and 
    output select button pins */
  attachInterrupt(OUTPUT_ENABLE_PIN, outputEnable, FALLING);
  attachInterrupt(OUTPUT_SELECT_PIN, outputSelect, FALLING);
}

void loop() {
  /* executes when only enable button has been pressed and calls the original waveform
     generation function to generate the waveform on the gpio pin */
  if((enableState == true)&&(selectState == false)){
    syncPulse();
    waveformGen();
    delayMicroseconds(idleTime);
  }

  /* executes when both enable and select button have been pressed and calls the alternative
     waveform generation function */
  if((enableState == true)&&(selectState == true)){
    syncPulse();
    WaveformGenAlt();
    delayMicroseconds(idleTime);
  }
}